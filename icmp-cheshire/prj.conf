## CMakeLists.txt
```
# SPDX-License-Identifier: Apache-2.0

cmake_minimum_required(VERSION 3.20.0)

find_package(Zephyr)
project(icmp_app)

target_sources(app PRIVATE src/main.c)
```

## prj.conf
```kconfig
# Networking
CONFIG_NETWORKING=y
CONFIG_NET_IPV4=y
CONFIG_NET_L2_ETHERNET=y
CONFIG_NET_ARP=y
CONFIG_NET_SOCKETS=y
CONFIG_NET_TCP=y

# LowRISC Ethernet driver
CONFIG_ETH_LOWRISC=y

# Shell
CONFIG_SHELL=y
CONFIG_NET_SHELL=y

# Console and shell
CONFIG_INCLUDE_RESET_VECTOR=y
CONFIG_CONSOLE=y
CONFIG_SERIAL=y
CONFIG_UART_CONSOLE=y
CONFIG_UART_NS16550_ACCESS_WORD_ONLY=y
CONFIG_CONSOLE_HANDLER=y
CONFIG_XIP=n
CONFIG_THREAD_MONITOR=y

# IP configuration
CONFIG_NET_CONFIG_SETTINGS=y
CONFIG_NET_CONFIG_MY_IPV4_ADDR="192.168.1.13"
CONFIG_NET_CONFIG_MY_IPV4_NETMASK="255.255.255.0"
CONFIG_NET_CONFIG_PEER_IPV4_ADDR="192.168.1.1"

# Entropy
CONFIG_ENTROPY_GENERATOR=y
CONFIG_TEST_RANDOM_GENERATOR=y

# Buffers
CONFIG_NET_PKT_RX_COUNT=32
CONFIG_NET_PKT_TX_COUNT=16
CONFIG_NET_BUF_RX_COUNT=64
CONFIG_NET_BUF_TX_COUNT=32
CONFIG_HEAP_MEM_POOL_SIZE=32768

# Latency optimizations
CONFIG_SYS_CLOCK_TICKS_PER_SEC=1000
CONFIG_NET_RX_STACK_SIZE=2048
CONFIG_NET_SOCKETS_POLL_MAX=8

# Default settings for M-Mode
CONFIG_RISCV_MACHINE_TIMER=y
CONFIG_RISCV_SUPERVISOR_TIMER=n

# Supervisor mode (comment the configs below to enable S-Mode)
# CONFIG_RISCV_SBI_BOOT=y
# CONFIG_RISCV_S_MODE=y
# CONFIG_RISCV_SUPERVISOR_TIMER=y
# CONFIG_RISCV_MACHINE_TIMER=n
```

## boards/cheshire_smode.overlay
```dts
&plic {
    interrupts-extended = <&hlic 9>;
};

&memory0 {
    reg = <0x0 0x80200000 0x0 0x8000000>;
};
```

## src/main.c
```c
#include <zephyr/kernel.h>

int main(void)
{
    printk("Zephyr Ready\n");
    printk("Networking initialized\n");
    printk("Do: net iface to see interfaces\n");
    printk("Do: net ping 192.168.1.x to ping localhost\n");
    printk("Test 2\n");
    
    return 0;
}
```
